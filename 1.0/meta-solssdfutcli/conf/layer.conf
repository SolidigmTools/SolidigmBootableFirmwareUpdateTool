## 1.0/meta-solssdfutcli/conf/layer.conf
```bitbake
# We have a conf and classes directory, add to BBPATH
BBPATH =. "${LAYERDIR}:"

# We have a packages directory, add to BBFILES
BBFILES += "${LAYERDIR}/recipes-*/*/*.bb \
            ${LAYERDIR}/recipes-*/*/*.bbappend"

BBFILE_COLLECTIONS += "solssdfutcli"
BBFILE_PATTERN_solssdfutcli = "^${LAYERDIR}/"
BBFILE_PRIORITY_solssdfutcli = "6"

LICENSE_PATH += "${LAYERDIR}/licenses"

LAYERSERIES_COMPAT_solssdfutcli = "thud morty"
```
